#include "stm32f103x6.h"
#include "gpio.h"
#include "hardware.h"

#define GPIO_CFG_BITS_PER_PIN          4U
#define GPIO_CFG_MASK                  0xFU
#define GPIO_CFG_INPUT_PULLUP          0x8U
#define GPIO_CFG_OUTPUT_PP_2MHZ        0x2U
#define GPIO_BSRR_RESET_OFFSET         16U

#define GPIO_CFG_SHIFT(pin)            ((pin) * GPIO_CFG_BITS_PER_PIN)
#define GPIO_BSRR_SET(pin)             (1U << (pin))
#define GPIO_BSRR_RESET(pin)           (1U << ((pin) + GPIO_BSRR_RESET_OFFSET))

void GPIO_Init_All(void)
{
    RCC->APB2ENR |= RCC_APB2ENR_AFIOEN;
    RCC->APB2ENR |= RCC_APB2ENR_IOPAEN;
    RCC->APB2ENR |= RCC_APB2ENR_IOPBEN;

    // Inputs
    
    BTN_LOCK_PORT->CRL &= ~(GPIO_CFG_MASK << GPIO_CFG_SHIFT(BTN_LOCK_PIN));
    BTN_LOCK_PORT->CRL |=  (GPIO_CFG_INPUT_PULLUP << GPIO_CFG_SHIFT(BTN_LOCK_PIN));

    BTN_UNLOCK_PORT->CRL &= ~(GPIO_CFG_MASK << GPIO_CFG_SHIFT(BTN_UNLOCK_PIN));
    BTN_UNLOCK_PORT->CRL |=  (GPIO_CFG_INPUT_PULLUP << GPIO_CFG_SHIFT(BTN_UNLOCK_PIN));

    BTN_ACTION_PORT->CRL &= ~(GPIO_CFG_MASK << GPIO_CFG_SHIFT(BTN_ACTION_PIN));
    BTN_ACTION_PORT->CRL |=  (GPIO_CFG_INPUT_PULLUP << GPIO_CFG_SHIFT(BTN_ACTION_PIN));

    MOTION_PORT->CRL &= ~(GPIO_CFG_MASK << GPIO_CFG_SHIFT(MOTION_PIN));
    MOTION_PORT->CRL |=  (GPIO_CFG_INPUT_PULLUP << GPIO_CFG_SHIFT(MOTION_PIN));

    // activate pull-ups
    BTN_LOCK_PORT->ODR |= GPIO_BSRR_SET(BTN_LOCK_PIN);
    BTN_UNLOCK_PORT->ODR |= GPIO_BSRR_SET(BTN_UNLOCK_PIN);
    BTN_ACTION_PORT->ODR |= GPIO_BSRR_SET(BTN_ACTION_PIN);
    MOTION_PORT->ODR |= GPIO_BSRR_SET(MOTION_PIN);

    // Outputs

    RELAY_LOCK_PORT->CRL &= ~(GPIO_CFG_MASK << GPIO_CFG_SHIFT(RELAY_LOCK_PIN));
    RELAY_LOCK_PORT->CRL |=  (GPIO_CFG_OUTPUT_PP_2MHZ << GPIO_CFG_SHIFT(RELAY_LOCK_PIN));

    RELAY_WINDOW_PORT->CRL &= ~(GPIO_CFG_MASK << GPIO_CFG_SHIFT(RELAY_WINDOW_PIN));
    RELAY_WINDOW_PORT->CRL |=  (GPIO_CFG_OUTPUT_PP_2MHZ << GPIO_CFG_SHIFT(RELAY_WINDOW_PIN));

    BUZZER_PORT->CRL &= ~(GPIO_CFG_MASK << GPIO_CFG_SHIFT(BUZZER_PIN));
    BUZZER_PORT->CRL |=  (GPIO_CFG_OUTPUT_PP_2MHZ << GPIO_CFG_SHIFT(BUZZER_PIN));

    LED_R_PORT->CRL &= ~(GPIO_CFG_MASK << GPIO_CFG_SHIFT(LED_R_PIN));
    LED_R_PORT->CRL |=  (GPIO_CFG_OUTPUT_PP_2MHZ << GPIO_CFG_SHIFT(LED_R_PIN));

    LED_G_PORT->CRL &= ~(GPIO_CFG_MASK << GPIO_CFG_SHIFT(LED_G_PIN));
    LED_G_PORT->CRL |=  (GPIO_CFG_OUTPUT_PP_2MHZ << GPIO_CFG_SHIFT(LED_G_PIN));

    LED_B_PORT->CRL &= ~(GPIO_CFG_MASK << GPIO_CFG_SHIFT(LED_B_PIN));
    LED_B_PORT->CRL |=  (GPIO_CFG_OUTPUT_PP_2MHZ << GPIO_CFG_SHIFT(LED_B_PIN));

    RELAY_LOCK_PORT->BSRR = GPIO_BSRR_RESET(RELAY_LOCK_PIN);
    RELAY_WINDOW_PORT->BSRR = GPIO_BSRR_RESET(RELAY_WINDOW_PIN);
    BUZZER_PORT->BSRR = GPIO_BSRR_RESET(BUZZER_PIN);
    LED_R_PORT->BSRR = GPIO_BSRR_RESET(LED_R_PIN);
    LED_G_PORT->BSRR = GPIO_BSRR_RESET(LED_G_PIN);
    LED_B_PORT->BSRR = GPIO_BSRR_RESET(LED_B_PIN);
}

void LED_Set(uint8_t r, uint8_t g, uint8_t b)
{
    if (r) LED_R_PORT->BSRR = GPIO_BSRR_SET(LED_R_PIN);
    else   LED_R_PORT->BSRR = GPIO_BSRR_RESET(LED_R_PIN);

    if (g) LED_G_PORT->BSRR = GPIO_BSRR_SET(LED_G_PIN);
    else   LED_G_PORT->BSRR = GPIO_BSRR_RESET(LED_G_PIN);

    if (b) LED_B_PORT->BSRR = GPIO_BSRR_SET(LED_B_PIN);
    else   LED_B_PORT->BSRR = GPIO_BSRR_RESET(LED_B_PIN);
}


void Relay_Lock_On()  { RELAY_LOCK_PORT->BSRR = GPIO_BSRR_SET(RELAY_LOCK_PIN); }
void Relay_Lock_Off() { RELAY_LOCK_PORT->BSRR = GPIO_BSRR_RESET(RELAY_LOCK_PIN); }

void Relay_Window_On()  { RELAY_WINDOW_PORT->BSRR = GPIO_BSRR_SET(RELAY_WINDOW_PIN); }
void Relay_Window_Off() { RELAY_WINDOW_PORT->BSRR = GPIO_BSRR_RESET(RELAY_WINDOW_PIN); }


void Buzzer_On()  { BUZZER_PORT->BSRR = GPIO_BSRR_SET(BUZZER_PIN); }
void Buzzer_Off() { BUZZER_PORT->BSRR = GPIO_BSRR_RESET(BUZZER_PIN); }


uint8_t Button_Read(uint8_t pin)
{
    return !(BTN_LOCK_PORT->IDR & GPIO_BSRR_SET(pin));
}

uint8_t Motion_Read(void)
{
    return !(MOTION_PORT->IDR & GPIO_BSRR_SET(MOTION_PIN));
}
